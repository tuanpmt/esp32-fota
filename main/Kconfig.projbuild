## main/Kconfig.projbuild
```kconfig
menu "FOTA Configuration"

config WIFI_SSID
    string "WiFi SSID"
	default "myssid"
	help
		SSID (network name) for the example to connect to.

config WIFI_PASSWORD
    string "WiFi Password"
	default "myssid"
	help
		WiFi password (WPA or WPA2) for the example to use.

		Can be left blank if the network has no security set.

config APIKEY
    string "FOTA Api Key"
	default "api-key"
	help
		HTTP Server IP to download the image file from.

		See example README.md for details.


endmenu
```
